## drivers/nubia/Kconfig
```kconfig
#
# Nubia drivers configuration
#

#menuconfig NUBIA_DRIVERS
menu "nubia drivers"

config NUBIA_DRIVERS
	bool "NUBIA DRIVERS"
	default n
	help
	  Say Y here if you want to enable NUBIA DRIVERS
	  If unsure, say N.

comment "Nubia Device Drivers"

if NUBIA_DRIVERS

config NUBIA_TOUCH
        bool "NUBIA_TOUCH"
        default n
        help
         Say Y here if you have enable NUBIA_TOUCH
         IF  unsure ,say N

config NUBIA_SENSORS
        bool "NUBIA_SENSORS"
        default n
        help
         Say Y here if you have enable NUBIA_SENSORS
         IF  unsure ,say N

config NUBIA_FINGERPRINT
        bool "NUBIA_FINGERPRINT"
        default y
        help
         Say Y here if you have enable NUBIA_FINGERPRINT
         IF  unsure ,say N

config NUBIA_MULTICOLORLIGHT
        bool "NUBIA_MULTICOLORLIGHT"
        default y
        help
         Say Y here if you have enable NUBIA_MUTICOLORLIGHT
         IF  unsure ,say N

config NUBIA_SENSORS_SENS
        bool "NUBIA_SENSORS_SENS"
        default n
        help
         Say Y here if you have enable NUBIA_MUTICOLORLIGHT
         IF  unsure ,say N

endif

if NUBIA_FINGERPRINT
source "drivers/nubia/fingerprint/Kconfig"
endif

if NUBIA_TOUCH
source "drivers/nubia/touch/Kconfig"
endif

if NUBIA_SENSORS
source "drivers/nubia/sensors/Kconfig"
endif

source "drivers/nubia/cy8c4014l_touchkey/Kconfig"

source "drivers/nubia/cc_control/Kconfig"

if NUBIA_SENSORS_SENS
source "drivers/nubia/sensors_sensitivity/Kconfig"
endif

endmenu

# Nubia configuration options

 config MACH_NUBIA
    bool "NUBIA device"
    depends on ARCH_QCOM
    help
      Support for Nubia products

 config MACH_NUBIA_SM7250
    bool "NUBIA SM7250"
    depends on ARCH_LITO
    select MACH_NUBIA
    help
      Support for SM7250 Nubia variants

menu "Nubia board selection"

 config MACH_NUBIA_NX651J
    bool "NUBIA_NX651J board"
    select MACH_NUBIA_SM7250
    help
      Support for Nubia Play 5G variant

 config MACH_NUBIA_NX651J_EEA
    bool "NUBIA_NX651J_EEA board"
    select MACH_NUBIA_SM7250
    help
      Support for Nubia Red Magic 5G Lite variant

endmenu
```

## drivers/nubia/cc_control/Kconfig
```kconfig
#
# Nubia usb cc pin control driver configuration
#

config NUBIA_USB_CC_CTRL
        bool "NUBIA_USB_CC_CTRL"
        default y
	help
	  This enables support for USB CC pin control to slow cc pin oxide.
```
